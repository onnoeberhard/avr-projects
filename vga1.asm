;****************************************************************************
;*																			*
;*							VGA Testbildgenerator							*
;*																			*
;****************************************************************************
;*																			*
;*	Einfacher VGA Testbildgenerator mit einem ATmega8.						*
;*	Der mega8 ist auf 22,1184MHz übertaktet, um schnell genug die Daten		*
;*	ausgeben zu können.	Besser sind 24MHz, aber das macht nicht jeder mega8	*
;*	mit, und außerdem sind die meisten 24MHz Quarze Oberwellenquarze.		*
;*	Mit dieser Taktfrequenz und den 8kB Flash ist immerhin eine Auflösung 	*
;*	von 128 x 124 Pixel bei	16 Farben möglich. Dabei wird der mega8 sowohl	*
;*	Geschwindigkeitsmäßig, als auch vom Speicherplatz her, voll ausgenutzt.	*
;*	Von den 8192Bytes sind immerhin noch 36 Bytes frei						*
;*	Der einfache DA Wandler aus 2x 3 Widerständen bildet zusammen mit dem 	*
;*	75 Ohm Eingangswiderstand einen Spannungsteiler, der ein Signal von		*
;*	etwa 1Vss liefert. Dies ergibt ein absolut scharfes Bild, ganz ohne 	*
;*	irgendwelche unscharfen Übergänge. Und die 2m Flachbandkabel geben auch	*
;*	ein recht gutes VGA Kabel ab :-)										*
;*	Über Timer0 wird die Horizontalfrequenz von etwa 31-32kHz erzeugt.		*
;*	Je nach Quarzfrequenz kann es passieren, dass aufgrund krummer 			*
;*	Timerwerte zwar im Mittel die Frequenz passt, aber die Periodendauer 	*
;*	nicht konstant ist. Daher Ist eventuell eine Anpassung notwendig, falls	*
;*	die Kanten beim Bild nicht glatt sondern starkt gezackt erscheinen.		*
;*																			*
;*	Bei diesem Program wurde mit allen Tricks gearbeitet, um eine möglichst	*
;*	hohe Geschwindigkeit und einen möglichst kleinen Code zu erreichen.		*
;*	z.B. wird eine Stackmaninpulation im Interrupt verwendet, um beim 		*
;*	Rücksprung immer bei Main zu landen.									*
;*	Alle Befehle sind von ihrer Ausführzeiteit her gezählt. Das hinzfügen	*
;*	eines weiteren Befehls kann das ganze Timing durcheinander bringen. 	*
;*																			*
;*	Die Bilddaten kann man theoretisch direkt aus einem 4bit (=16 Farben)	*
;*	BMP importieren, wenn man es vorher horizontal spiegelt (d.h. auf den 	*
;*	Kopf stellt) und den Header entfernt (54Bytes + 64Bytes Farbtabelle)	*
;*	Wenn das Bild mit 128x124 gespeichert wurde, müssten dann genau 7963	*
;*	Werte übrig bleiben. Damit die Farben passen, muss es mit der Standard 	*
;*	Farbpalette gespeichert werden, also 									*
;*	schwarz, blau, grün, türkis, rot, lila, gelb, grau usw.					*
;*	oder mit einer anderen Palette, bei der aber jeder Farbe ein Bit		*
;*	zugeordnet wird und Bit 3 die Helligkeit verdoppelt.					*
;*	Dementsprechen müssen dann auch RGB an die Ausgänge PC0-2 angeschlossen	*
;*	werden.																	*
;*	Ob das ganze Sync Timing dem VGA Standard entspricht weiß ich nicht,	*
;*	aber es funktioniert auf jedenfall auf all meinen Monitoren, und die	*
;*	Regler zum verschieben des Bildes sind alles etwa in Mittelstellung.	*
;*	Das einzige was ganz sicher nicht passt, ist die Breite des Bildes,		*
;*	denn dazu wären mindestens 24MHz Taktfrequenz notwendig.				*
;*																			*
;****************************************************************************

.include "m8def.inc"	;	@22,1184MHz

;Port D
.equ VSync = 0			;VSync direkt an Monitor
.equ HSync = 1			;HSync direkt an Monitor

;Port C
.equ R = 0				;R 		  über 680 Ohm
.equ G = 1				;G 		  über 680 Ohm
.equ B = 2				;B 		  über 680 Ohm
.equ C = 3				;R,G,B je über 1k Ohm

.equ CPUClk = 22118.4 	;Quarztakt in kHz
.equ VStart	= 0			;Beginng von VSync in Zeile : 500 + x
.equ VLang 	= 5			;VSync Länge in Zeilen
.equ Offs	= 15		;Beginn des neuen Bildes, x Zeilen nach Ende von VSync

.def null=r1
.def eins=r2
.def sv=r3
.def dz=r4
.def temp=r16
.def Reload=r17
.def ZeileL=r18
.def ZeileH=r19
.def temp3=r20
.def temp4=r21

.org 0
rjmp Initialisierung

.org OVF0addr
out TCNT0, Reload
rjmp Timer

Initialisierung:
clr null
ldi temp, 1
mov eins, temp

ldi temp, 64					;Zeilenlänge: 64Bytes
mov sv, temp

ldi temp, 64					;x / 256, Anzahl an Datenzeilen pro Monitorzeile, hier 64/256, also 1/4
mov dz, temp

clr temp4						;interner Adresszähler
clr temp3

ldi XL, LOW(RAMEND)				;Stackpointer initialisieren und in X Register laden
out SPL, XL

ldi XH, HIGH(RAMEND)			;Stackpointer initialisieren und in X Register laden
out SPH, XH

ldi temp, (1<<TOIE0)			;Timer0 Interrupt aktivieren
out TIMSK, temp

ldi temp, 2						;Teiler auf 8
out TCCR0, temp

ldi Reload, 255-(CPUClk/8/32)	;32kHz Horizontalfrequenz
out TCNT0, Reload

clr ZeileL						;Zeilenzähler
clr ZeileH
ser temp
out portd, temp
out ddrc,  temp					;Grafikdaten
out ddrd,  temp					;Sync

sei

Main:	
	swap r0						;1 Takt
	out	portc,r0				;4 Takte seit letztem Wert -> 5,53MHz Pixeltakt
	lpm							;3 Takte
	swap r0						;1 Takt
	out	portc,r0				;4 Takte seit letztem Wert -> 5,53MHz Pixeltakt
	inc r30						;1 Takt
rjmp Main						;2 Takte

Timer:					
	out portc, null
	cbi PortD, HSync			;H-Sync: Low
	add ZeileL, eins			;Zeilenzähler
	adc ZeileH, Null
	ldi temp, Main
	st X, temp					;Return Adresse des Interrupts = Main
	add temp4, dz				;4 Zeilen lang dasselbe anzeigen
	brcc skipa					;4 Zeilen vorüber ?
	add temp3, sv				;neue Zeilenadresse im RAM laden (+64, da 64Bytes/Zeile)
skipa:
	adc r31, null				;Adresszähler High Byte
	mov r30, temp3				;Adresszähler Low Byte
	cpi ZeileH, 2				;Zeile 512 erreicht ?
	breq ZeilenC				;VSync Routine
	nop					
	nop					
	nop							;H-Sync Länge und Timinganpassung
	nop							;Eventuell Anpassung an gerade/ungerade Werte vom Timer Reloadwert
	nop							;durch Hinzufügen eines weiteren nop eventuell notwendig !
	nop
	nop
	nop
	nop
	sbi PortD, HSync			;Synclänge: 22 Takte, entsprechend 1us bei 22,1184MHz
reti	

ZeilenC:	
	ldi r30, 192				;erste Datenzeile = schwarz
	clr r31						;während VSync aktiv ist -> Bild schwarz

	cpi ZeileL,VStart			;VSync Beginn ? (bei Zeile 512+VStart)
	brne Sel1	
	cbi PortD, VSync			;V-Sync: 31,5kHz / 525 Zeilen = 60Hz
	rjmp ExInt
Sel1:
	cpi ZeileL,VStart+VLang		;VSync Ende ? (bei Zeile 512+VStart+VLang)
	brne Sel2
	sbi PortD, VSync
	rjmp ExInt
Sel2:
	cpi ZeileL,VStart+VLang+Offs;Beginn von neuem Bild ? (bei Zeile 512+VStart+VLang+Offs)
	brne ExInt
	ldi ZeileL, 12				;VSync Ende -> Zeilenzähler Reset (12 daher, denn 125 Daenzeilen*4=500 Zeilen, 500+12=512)
	clr ZeileH
	ldi temp3, 192				;VSync Ende -> Adresszähler = Beginn der Bilddaten
	clr temp4	
ExInt:
	sbi PortD, HSync
reti

.org 0x60	;64 Bytes schwarz: Zeile für Blanking während VSync
.db 0x00,0x00,0x00,0x00,0x00,0x00,0x00,0x00,0x00,0x00,0x00,0x00,0x00,0x00,0x00,0x00,0x00,0x00,0x00,0x00,0x00,0x00,0x00,0x00,0x00,0x00,0x00,0x00,0x00,0x00,0x00,0x00,0x00,0x00,0x00,0x00,0x00,0x00,0x00,0x00,0x00,0x00,0x00,0x00,0x00,0x00,0x00,0x00,0x00,0x00,0x00,0x00,0x00,0x00,0x00,0x00,0x00,0x00,0x00,0x00,0x00,0x00,0x00,0x00


.org 0x80	;7936 Byte Grafikdaten: 128 x 124 x 16 Farben 
.db 0x00,0x00,0x00,0x00,0x00,0x00,0x00,0x00,0x00,0x00,0x00,0x00,0x00,0x00,0x00,0x00,0x00,0x00,0x00,0x00,0x00,0x00,0x00,0x00,0x00,0x00,0x00,0x00,0x00,0x00,0x00,0x00,0x00,0x00,0x00,0x00,0x00,0x00,0x00,0x00,0x00,0x00,0x00,0x00,0x00,0x00,0x00,0x00,0x00,0x00,0x00,0x00,0x00,0x00,0x00,0x00,0x00,0x00,0x00,0x00,0x00,0x00,0x00,0x00
.db 0x00,0x00,0x00,0x00,0x00,0x00,0x00,0x00,0x00,0x00,0x00,0x00,0x00,0x00,0x00,0x00,0x00,0x00,0x00,0x00,0x00,0x00,0x00,0x00,0x00,0x00,0x00,0x00,0x00,0x00,0x00,0x00,0x00,0x00,0x00,0x00,0x00,0x00,0x00,0x00,0x00,0x00,0x00,0x00,0x00,0x00,0x00,0x00,0x00,0x00,0x00,0x00,0x00,0x00,0x00,0x00,0x00,0x00,0x00,0x00,0x00,0x00,0x00,0x00
.db 0x00,0x00,0x00,0x00,0x00,0x00,0x00,0x00,0x00,0x00,0x00,0x00,0x00,0x00,0x00,0x00,0x00,0x00,0x00,0x00,0x00,0x00,0x00,0x00,0x00,0x00,0x00,0x00,0x00,0x00,0x00,0x00,0x00,0x00,0x00,0x00,0x00,0x00,0x00,0x00,0x00,0x00,0x00,0x00,0x00,0x00,0x00,0x00,0x00,0x00,0x00,0x00,0x00,0x00,0x00,0x00,0x00,0x00,0x00,0x00,0x00,0x00,0x00,0x00
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.db 0x00,0x00,0x00,0x00,0x00,0x00,0x00,0x00,0x00,0x00,0x00,0x00,0x00,0x00,0x00,0x00,0x00,0x00,0x00,0x00,0x00,0x00,0x00,0x00,0x00,0x00,0x00,0x00,0x00,0x00,0x00,0x00,0x00,0x00,0x00,0x00,0x00,0x00,0x00,0x00,0x00,0x00,0x00,0x00,0x00,0x00,0x00,0x00,0x00,0x00,0x00,0x00,0x00,0x00,0x00,0x00,0x00,0x00,0x00,0x00,0x00,0x00,0x00,0x00